## build_bbb/conf/bblayers.conf
```bitbake
# POKY_BBLAYERS_CONF_VERSION is increased each time build/conf/bblayers.conf
# changes incompatibly
POKY_BBLAYERS_CONF_VERSION = "2"

BBPATH = "${TOPDIR}"
BBFILES ?= ""

BBLAYERS ?= " \
  ${TOPDIR}/../poky/meta \
  ${TOPDIR}/../poky/meta-poky \
  ${TOPDIR}/../poky/meta-yocto-bsp \
  \
  ${TOPDIR}/../layers/meta-openembedded/meta-oe \
  \
  \
  ${TOPDIR}/../layers/meta-mylayer \
  \
  \
  ${TOPDIR}/../layers/meta-ti/meta-ti-bsp \
  ${TOPDIR}/../layers/meta-ti/meta-ti-extras \
  ${TOPDIR}/../layers/meta-arm/meta-arm \
  ${TOPDIR}/../layers/meta-arm/meta-arm-toolchain \
  "
```

## layers/meta-mylayer/conf/distro/mydistro.conf
```bitbake
require conf/distro/poky.conf

DISTRO = "mydistro"
DISTRO_NAME = "My Custom Distro"
DISTRO_VERSION = "1.0"

INIT_MANAGER = "systemd"

DISTRO_FEATURES:append = " x11 wayland pam"

VIRTUAL-RUNTIME_init_manager = "systemd"
DISTRO_FEATURES_BACKFILL_CONSIDERED = "sysvinit"
VIRTUAL-RUNTIME_initscripts = ""
```
